AUTOSAR XML (schema 4-0-3)
package /Ecuc
  module config Os: ecuc-def-edition=4.2.0, implementation-config-variant=VARIANT-PRE-COMPILE
    OsInclude: OsIncludeFileName=test_histogram.h
    AppMode (OsAppMode)
    OsOS: OsStackMonitoring=true, OsUseGetServiceId=true, OsUseParameterAccess=true, OsScalabilityClass=SC1, OsStatus=EXTENDED
      OsHooks: OsErrorHook=true, OsPostTaskHook=true, OsPreTaskHook=true, OsProtectionHook=true, OsShutdownHook=true, OsStartupHook=true
      OsHookStack: OsHookStackSize=512
    USRV_TASK (OsTask):
      OsTaskActivation = 1U
      OsTaskPriority = (TMAX_TPRI - USRV_MAIN_PRIORITY)
      OsTaskStackSize = USRV_STACK_SIZE
      OsTaskSchedule = FULL
      OsTaskResourceRef = RES_UDP_CEP_LOCK1
      OsTaskResourceRef = RES_UDP_CEP
      OsTaskResourceRef = RES_IP2STR_BUFF_LOCK
      OsTaskEventRef = EVT_USRV
      OsTaskAutostart: OsTaskAppModeRef=AppMode
    EVT_USRV (OsEvent)
    ALM_USRV (OsAlarm): OsAlarmCounterRef=MAIN_HW_COUNTER
      OsAlarmAction
        OsAlarmSetEvent: OsAlarmSetEventTaskRef=USRV_TASK, OsAlarmSetEventRef=EVT_USRV
