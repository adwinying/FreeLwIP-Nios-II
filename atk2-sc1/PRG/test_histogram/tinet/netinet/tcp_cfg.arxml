AUTOSAR XML (schema 4-0-3)
package /Ecuc
  module config Os: ecuc-def-edition=4.2.0, implementation-config-variant=VARIANT-PRE-COMPILE
    TCP_OUTPUT_TASK (OsTask):
      OsTaskActivation = 1U
      OsTaskPriority = (TMAX_TPRI - TCP_OUT_TASK_PRIORITY)
      OsTaskStackSize = TCP_OUT_TASK_STACK_SIZE
      OsTaskSchedule = FULL
      OsTaskResourceRef = RES_TCP_CEP
      OsTaskEventRef = EVT_TCP_POST_OUTPUT
    EVT_TCP_POST_OUTPUT (OsEvent)
    RES_TCP_CEP (OsResource): OsResourceProperty=STANDARD
