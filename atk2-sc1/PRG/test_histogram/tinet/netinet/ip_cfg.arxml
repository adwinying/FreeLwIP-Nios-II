AUTOSAR XML (schema 4-0-3)
package /Ecuc
  module config Os: ecuc-def-edition=4.2.0, implementation-config-variant=VARIANT-PRE-COMPILE
    RES_IP4_FRAG_QUEUE (OsResource): OsResourceProperty=STANDARD
    RES_IN_ROUTING_TBL (OsResource): OsResourceProperty=STANDARD
