AUTOSAR XML (schema 4-0-3)
package /Ecuc
  module config Os: ecuc-def-edition=4.2.0, implementation-config-variant=VARIANT-PRE-COMPILE
    RES_ARP_CACHE_LOCK (OsResource): OsResourceProperty=STANDARD
