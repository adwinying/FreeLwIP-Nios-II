AUTOSAR XML (schema 4-0-3)
package /Ecuc
  module config Os: ecuc-def-edition=4.2.0, implementation-config-variant=VARIANT-PRE-COMPILE
    NET_TIMER_TASK (OsTask):
      OsTaskActivation = 1U
      OsTaskPriority = (TMAX_TPRI - NET_TIMER_PRIORITY)
      OsTaskStackSize = NET_TIMER_STACK_SIZE
      OsTaskSchedule = FULL
      OsTaskResourceRef = RES_IP4_FRAG_QUEUE
      OsTaskResourceRef = RES_IN_ROUTING_TBL
      OsTaskResourceRef = RES_ARP_CACHE_LOCK
      OsTaskResourceRef = RES_CALL_OUT_LOCK
      OsTaskEventRef = EVT_CALL_OUT_TIMEOUT
    NET_TIMER_ALARM (OsAlarm): OsAlarmCounterRef=MAIN_HW_COUNTER
      OsAlarmAction
        OsAlarmSetEvent: OsAlarmSetEventTaskRef=NET_TIMER_TASK, OsAlarmSetEventRef=EVT_CALL_OUT_TIMEOUT
      OsAlarmAutostart:
        OsAlarmAlarmTime = (TIMER_CLOCK_HZ / 1000)
        OsAlarmCycleTime = (NET_TIMER_CYCLE * (TIMER_CLOCK_HZ / 1000))
        OsAlarmAutostartType = ABSOLUTE
        OsAlarmAppModeRef = AppMode
    RES_CALL_OUT_LOCK (OsResource): OsResourceProperty=STANDARD
    EVT_CALL_OUT_TIMEOUT (OsEvent)
    RES_IP2STR_BUFF_LOCK (OsResource): OsResourceProperty=STANDARD
