AUTOSAR XML (schema 4-0-3)
package /Ecuc
  module config Os: ecuc-def-edition=4.2.0, implementation-config-variant=VARIANT-PRE-COMPILE
    ETHER_OUTPUT_TASK (OsTask):
      OsTaskActivation = 1U
      OsTaskPriority = (TMAX_TPRI - ETHER_OUTPUT_PRIORITY)
      OsTaskStackSize = ETHER_OUTPUT_STACK_SIZE
      OsTaskSchedule = FULL
      OsTaskEventRef = EVT_ETHER_OUTPUT
      OsTaskEventRef = EVT_IF_TSE_SBUF_READY
    ETHER_INPUT_TASK (OsTask):
      OsTaskActivation = 1U
      OsTaskPriority = (TMAX_TPRI - ETHER_INPUT_PRIORITY)
      OsTaskStackSize = ETHER_INPUT_STACK_SIZE
      OsTaskSchedule = FULL
      OsTaskResourceRef = RES_IP4_FRAG_QUEUE
      OsTaskResourceRef = RES_MAC2STR_BUFF_LOCK
      OsTaskResourceRef = RES_ARP_CACHE_LOCK
      OsTaskResourceRef = RES_CALL_OUT_LOCK
      OsTaskResourceRef = RES_IP2STR_BUFF_LOCK
      OsTaskEventRef = EVT_IF_TSE_RBUF_READY
      OsTaskAutostart: OsTaskAppModeRef=AppMode
    EVT_ETHER_OUTPUT (OsEvent)
    RES_MAC2STR_BUFF_LOCK (OsResource): OsResourceProperty=STANDARD
