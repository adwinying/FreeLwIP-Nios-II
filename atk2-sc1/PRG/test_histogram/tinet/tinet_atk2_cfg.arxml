AUTOSAR XML (schema 4-0-3)
package /Ecuc
  module config Os: ecuc-def-edition=4.2.0, implementation-config-variant=VARIANT-PRE-COMPILE
    OsInclude:
      OsIncludeFileName = target_sysmod.h
      OsIncludeFileName = Std_Types.h
      OsIncludeFileName = tinet_defs.h
      OsIncludeFileName = tinet_config.h
      OsIncludeFileName = net/if.h
      OsIncludeFileName = net/ethernet.h
      OsIncludeFileName = net/if_arp.h
      OsIncludeFileName = net/net.h
      OsIncludeFileName = net/net_buf.h
      OsIncludeFileName = net/net_timer.h
      OsIncludeFileName = net/ether_var.h
      OsIncludeFileName = netinet/in.h
      OsIncludeFileName = netinet/ip.h
      OsIncludeFileName = netinet/ip_var.h
      OsIncludeFileName = netinet/tcp.h
      OsIncludeFileName = netinet/tcp_timer.h
      OsIncludeFileName = netinet/tcp_var.h
      OsIncludeFileName = netinet/udp_var.h
      OsIncludeFileName = tinet_cfg.h
