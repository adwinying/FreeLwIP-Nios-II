AUTOSAR XML (schema 4-0-3)
package /Ecuc
  module config Os: ecuc-def-edition=4.2.0, implementation-config-variant=VARIANT-PRE-COMPILE
    if_tse_tx_handler (OsIsr): OsIsrInterruptNumber=INTNO_IF_TSE_TX, OsIsrInterruptPriority=INTPRI_IF_TSE, OsIsrCategory=CATEGORY_2
    if_tse_rx_handler (OsIsr): OsIsrInterruptNumber=INTNO_IF_TSE_RX, OsIsrInterruptPriority=INTPRI_IF_TSE, OsIsrCategory=CATEGORY_2
    EVT_IF_TSE_SBUF_READY (OsEvent)
    EVT_IF_TSE_RBUF_READY (OsEvent)
